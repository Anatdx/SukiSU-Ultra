## kernel/Kconfig
```kconfig
menu "KernelSU"

config KSU
	  tristate "KernelSU function support"
	  default y
	  help
		Enable kernel-level root privileges on Android System.
		To compile as a module, choose M here: the
		module will be called kernelsu.

config KSU_DEBUG
	  bool "KernelSU debug mode"
	  depends on KSU
	  default n
	  help
		Enable KernelSU debug mode.

config KSU_ALLOWLIST_WORKAROUND
	bool "KernelSU Session Keyring Init workaround"
	depends on KSU
	default n
	help
	  Enable session keyring init workaround for problematic devices.
	  Useful for situations where the SU allowlist is not kept after a reboot

config KSU_MANUAL_SU
	bool "Use manual su"
	depends on KSU
	default y
	help
	  Use manual su and authorize the corresponding command line and application via fd

config KSU_MULTI_MANAGER_SUPPORT
	bool "Multi KernelSU manager support"
	depends on KSU
	default n
	help
		Enable multi KernelSU manager support

config KPM
	  bool "Enable YukiSU KPM"
	  depends on KSU && 64BIT
	  select KALLSYMS
	  select KALLSYMS_ALL
	  default n
	  help
		Enabling this option will activate the KPM feature of YukiSU.
		This option is suitable for scenarios where you need to force KPM to be enabled.
		but it may affect system stability.

config KSU_MANUAL_HOOK
	bool "Hook KernelSU manually"
	depends on KSU != m && !KSU_HYMOFS
	help
	  If enabled, Hook required KernelSU syscalls with manually-patched function.
	  This can be used together with KSU_HYMOFS for complete functionality.

config KSU_MANUAL_HOOK_AUTO_SETUID_HOOK
	bool "Automatically hook setuid by lsm"
	depends on KSU_MANUAL_HOOK
	default y
	help
	  If turn off this option, you need checkout to kernel/sys.c 
	  in SYSCALL_DEFINE3(setresuid, uid_t, ruid, uid_t, euid, uid_t, suid)
	  add a ksu_handle_setresuid calls in there

endmenu
```
